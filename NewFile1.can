/*@!Encoding:1252*/
includes
{
  
}

variables
{
 int a=10; 
}
on start
{
  write("################let's get started#################");
}
